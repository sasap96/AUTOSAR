AUTOSAR XML (schema 4-0-3)
package /COM/VECTOR/CFG/WORKFLOW/SYSDESC/SYNC
  flat map FLATMAP
    7 x flat instance descriptor:
      ComponentPrototype: upstream-reference=ECU_Composition.CpCoApplication.CpSaInteriorLightFront, ecu-extract-reference=COMPOSITIONTYPE.CpSaInteriorLightFront
      ComponentPrototype_001: upstream-reference=ECU_Composition.CpCoApplication.CpSaDoorFrontRight, ecu-extract-reference=COMPOSITIONTYPE.CpSaDoorFrontRight
      ComponentPrototype_002: upstream-reference=ECU_Composition.CpCoApplication.CpSaDoorFrontLeft, ecu-extract-reference=COMPOSITIONTYPE.CpSaDoorFrontLeft
      ComponentPrototype_003: upstream-reference=ECU_Composition.CpCoApplication.CpApMySwc, ecu-extract-reference=COMPOSITIONTYPE.CpApMySwc
      AssemblySwConnector: ecu-extract-reference=CpApMySwcDPpLightStateFrontDCpSaInteriorLightFrontDPpLightState
      AssemblySwConnector_001: ecu-extract-reference=CpSaDoorFrontLeftDPpDooStateDCpApMySwcDPpDoorStateFrontLeft
      AssemblySwConnector_002: ecu-extract-reference=CpSaDoorFrontRightDPpDooStateDCpApMySwcDPpDoorStateFrontRight

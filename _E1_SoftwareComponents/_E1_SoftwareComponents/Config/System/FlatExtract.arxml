AUTOSAR XML (schema 4-2-1)
package /COM/VECTOR/CFG/WORKFLOW/SYSDESC/SYNC
  system SYSTEM
    system mapping MAPPINGS
    root-software-compositions:
      root sw composition prototype COMPOSITIONTYPE: flat-map=FLATMAP, software-composition=COMPOSITIONTYPE
  composition sw component type COMPOSITIONTYPE
    10 x component:
      Dem: type=Dem
      Det: type=Det
      EcuM: type=EcuM
      NvM: type=NvM
      ComM: type=ComM
      BswM: type=BswM
      CpSaInteriorLightFront: type=CtSaInteriorLight
      CpSaDoorFrontRight: type=CtSaDoor
      CpSaDoorFrontLeft: type=CtSaDoor
      CpApMySwc: type=CtApMySwc
    connect CpApMySwc.PpLightStateFront -> CpSaInteriorLightFront.PpLightState
    connect CpSaDoorFrontLeft.PpDooState -> CpApMySwc.PpDoorStateFrontLeft
    connect CpSaDoorFrontRight.PpDooState -> CpApMySwc.PpDoorStateFrontRight
  end to end protection set E2EPROTECTIONSET
  port interface mapping set PORTINTERFACEMAPPINGSET
